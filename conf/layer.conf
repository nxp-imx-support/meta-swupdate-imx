## conf/layer.conf
```bitbake
# We have a conf and classes directory, add to BBPATH
BBPATH .= ":${LAYERDIR}"

BBMASK = "${LAYERDIR}/recipes-devtools"

# We have a recipes directory, add to BBFILES
BBFILES += "${LAYERDIR}/recipes-*/*/*.bb \
	${LAYERDIR}/recipes-*/*/*.bbappend"

BBFILE_COLLECTIONS += "swupdate-imx"
BBFILE_PATTERN_swupdate-imx := "^${LAYERDIR}/"
BBFILE_PRIORITY_swupdate-imx = "7"

LAYERSERIES_COMPAT_swupdate-imx = "dunfell hardknott honister kirkstone"

LAYERDEPENDS_swupdate-imx = "openembedded-layer"

PREFERRED_VERSION_swupdate = "2022.05"
```
